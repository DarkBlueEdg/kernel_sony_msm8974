## arch/arm/hotplug/Kconfig
```kconfig
config INTELLI_PLUG
        bool "Enable intelli-plug cpu hotplug driver (New)"
        default n
        help
          Generic Intelli-plug cpu hotplug driver for ARM SOCs
```
